/*
 * ACOSTA CHACA MAXEL DAVID
 * TAREA 3: Realizar un contador binario hasta 6 bits. Cuando se presione un pulsador, se debe observar el aumento de la variable en su número binario visto en leds
 * SOLUCION:
 * eL CONTADOR BINARIO DE 6 BITS OBVIAMENTE LLEGARA SOLO HASTA CUMPLIR 111111 Y LUEGO SE REINICIARA ASI QUE
 * PARA PODER DEFINIR LA SENTANCIA IF SE ESTABLECE QUE DESPUES DEL NUMERO 63 NUESTRO CONTADOR DE PULSOS
 * VUELVA A CER
 * SENTENCIAS UTILIZADAS:
 *          IF=PARA LEER NUESTRO DATO DE ENTRADA DEL BOTON ESTE CASO SE ACTIVA EN LOW Y LO MENCIONADO ANTES
 *          FOR=PARA DEFINIR LOS 6 LEDS DE SALIDA EN EL SETUP
 */
// DEFINIMOS LAS VARIABLES
int J;
int NUMEROS=0; 
int VALOR;  
#define PULSO 8
int LED[6]={2,3,4,5,6,7};

void setup() {
 pinMode(PULSO, INPUT); // PULSO SERA NUESTRO VALOR DE ENTRADA DEL PIN 8 DEL ARDUINO DONDE ESTA NUESTRO BOTON
for(J=0;J<=6;J++){ 
pinMode(LED[J], OUTPUT); //LED ES NUESTRA SALIDA DE ARREGLO DE LOS LEDS
}
}
void loop() {
if (digitalRead(PULSO)==LOW){ //SI SE PRESIONA EL BOTON SE OBTIENE UN LOW Y ESPERAMOS A QUE RECONOZCA PARA ESO SE PONE EL SECUENCIA EL DELAY
delay(350);
NUMEROS++; //EL INCREMENTO ES DE 1
if (NUMEROS>63){
NUMEROS=0; //SE REINICIA COMO MENCIONAMOS
}
while (digitalRead(PULSO)==HIGH){}
}
VALOR=NUMEROS;
 
for(J=0; J<=6; J++){ 
digitalWrite(LED[J], VALOR%2); //CONVIERTE EL CONTEO DEL PULSO EN UN SISTEMA DE ARREGLO BINARIO TOMANDO DE IGUAL MANERA CADA RESIDUO Y DIVIDIRLO PARA 2
VALOR=VALOR/2;
}
}
